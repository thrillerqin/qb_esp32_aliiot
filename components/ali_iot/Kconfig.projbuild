## components/ali_iot/Kconfig.projbuild
```kconfig
menu "ALI_IOT'S FUNCTION"
	config ALI_IOT
		bool "ENABLE ali iot"
		default "n"
endmenu
```

## components/my_gpio/Kconfig.projbuild
```kconfig
menu "MY_GPIO"
config MY_GPIO_ENABLE
bool "ENABLE my_gpio"
default "y"
endmenu


menu "my gpio Configuration"

config MY_BLINK_GPIO
    int "Blink GPIO number"
	range 0 34
	default 5
	help
		GPIO number (IOxx) to blink on and off.

		Some GPIOs are used for other purposes (flash connections, etc.) and cannot be used to blink.

		GPIOs 35-39 are input-only so cannot be used as outputs.

endmenu
```
